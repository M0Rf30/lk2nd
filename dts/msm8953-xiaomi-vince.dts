// SPDX-License-Identifier: GPL-2.0-only

/dts-v1/;

/include/ "msm8953.dtsi"

/ {
	// This is used by the bootloader to find the correct DTB 
	qcom,msm-id = <293 0x0>;
	qcom,board-id= <0x1000b 0x8>;

	model = "Xiaomi Redmi Note 5 / 5 Plus Snapdragon (vince)";
	compatible = "xiaomi,vince", "qcom,msm8953", "lk2nd,device";
	lk2nd,pstore = <0x9ff00000 0x100000>;

	panel {
		compatible = "xiaomi,vince-panel";

		qcom,mdss_dsi_xia_tianma_td4310_fhdplus_e7_vid_v0 {
			compatible = "tianma,td4310_fhdplus_e7";
		};
	};
};
